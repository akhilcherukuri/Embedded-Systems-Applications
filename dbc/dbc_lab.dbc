VERSION ""

NS_ :

BS_:

BU_: SENSOR SWITCH LED

BO_ 50 SENSOR_ACCELEROMETER: 2 SENSOR
 SG_ SENSOR_ACCELEROMETER_cmd : 0|16@1+ (1,0) [0|4095] "" LED

BO_ 100 SENSOR_SWITCH: 1 SWITCH
 SG_ SWITCH_cmd : 0|1@1+ (1,0) [0|0] "" LED
